/*******************************************************************************
*                 
*                 		       普中科技
--------------------------------------------------------------------------------
* 实 验 名		 : 点阵显示试验
* 实验说明       : 点阵流动显示1、2、3、4.....
* 连接方式       : 见连接图
* 注    意		 : 
*******************************************************************************/


#include<reg51.h>

//--定义要使用的IO口--//
#define READPORTS 		P2
#define GREENPORTS 		P1
#define COMMONPORTS		P0

//--列选通控制--//
unsigned char code TAB[8]  = {0x7f,0xbf,0xdf,0xef,0xf7,0xfb,0xfd,0xfe};

//--点阵字码--//
unsigned char code CHARCODE[18][8]={

{0x00,0x00,0x3e,0x41,0x41,0x41,0x3e,0x00}, //0

{0x00,0x00,0x00,0x00,0x21,0x7f,0x01,0x00}, //1
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{0x7C,0x48,0x48,0xFF,0x48,0x48,0x7C,0x00}  //中

};

/*******************************************************************************
* 函数名         : main
* 函数功能		   : 主函数
* 输入           : 无
* 输出         	 : 无
*******************************************************************************/

void main()
{	
 	unsigned char tab, j;
	unsigned int  i;

	while(1)
	{	
		for(i= 0; i<5000; i++ )   //两个字之间的扫描间隔时间
		{
			for(tab=0;tab<8;tab++)
			{	
				READPORTS=0xFF;				   //消隐
				COMMONPORTS=CHARCODE[j][tab];  //输出字码
				READPORTS=TAB[tab];			   
			}
		}
		j++;
		if(j == 18)
		{
			j = 0;
		}
	}	
}